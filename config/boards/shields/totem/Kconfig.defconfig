## config/boards/shields/totem/Kconfig.defconfig
```kconfig
# Copyright (c) 2022 The ZMK Contributors
# SPDX-License-Identifier: MIT

if SHIELD_PULSO_DONGLE

config ZMK_KEYBOARD_NAME
    default "PULSO"
    
config ZMK_SPLIT_ROLE_CENTRAL
    default y

config ZMK_USB
    default y

endif

if SHIELD_PULSO_LEFT || SHIELD_PULSO_RIGHT || SHIELD_PULSO_DONGLE

config ZMK_SPLIT
    default y

config ZMK_BLE
    default y

endif
```

## config/boards/shields/totem/Kconfig.shield
```kconfig
# Copyright (c) 2022 The ZMK Contributors
# SPDX-License-Identifier: MIT

config SHIELD_PULSO_LEFT
    def_bool $(shields_list_contains,pulso_left)

config SHIELD_PULSO_RIGHT
    def_bool $(shields_list_contains,pulso_right)

config SHIELD_PULSO_DONGLE
    def_bool $(shields_list_contains,pulso_dongle)
```
